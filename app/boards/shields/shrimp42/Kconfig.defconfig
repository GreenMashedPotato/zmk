## app/boards/shields/shrimp42/Kconfig.defconfig
```kconfig
# Copyright (c) 2020 The ZMK Contributors
# SPDX-License-Identifier: MIT

if SHIELD_SHRIMP42_LEFT

config ZMK_KEYBOARD_NAME
    default "Shrimp42"

config ZMK_SPLIT_ROLE_CENTRAL
    default y

endif


if SHIELD_SHRIMP42_LEFT || SHIELD_SHRIMP42_RIGHT

config ZMK_SPLIT
    default y

endif
```

## app/boards/shields/shrimp42/Kconfig.shield
```kconfig
# Copyright (c) 2020 The ZMK Contributors
# SPDX-License-Identifier: MIT

config SHIELD_SHRIMP42_LEFT
    def_bool $(shields_list_contains,shrimp42_left)

config SHIELD_SHRIMP42_RIGHT
    def_bool $(shields_list_contains,shrimp42_right)
```
